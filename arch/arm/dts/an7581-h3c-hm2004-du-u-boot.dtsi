// SPDX-License-Identifier: (GPL-2.0-only OR BSD-2-Clause)

#include "an7581-u-boot.dtsi"
#include "an758x-recovery-layout-u-boot.dtsi"

status_led: &{/leds/led-power} {
};

#include "an758x-status-led-u-boot.dtsi"

/*
 * The board-data volume must stay in lockstep with the Linux UBI volume table
 * in ponwrt's target/linux/airoha/dts/an7581-h3c-hm2004-du.dts, which declares
 * a single "factory" volume holding the compact 1 MiB H3C layout:
 *
 *   0x0000  magic "H3C-1MiB"          0x0010  label / lan1 MAC
 *   0x0020  eth0 MAC                  0x0030  pon0 MAC
 *   0x0040  5G radio MAC              0x0050  2.4G radio MAC
 *   0x0060  device SN (12-byte ASCII) 0x1000  Wi-Fi EEPROM (MT7916, 0x1000)
 *   0x2000  PON calibration (EN7572, 0x200)
 *
 * net/lwip/httpd.c:create_recovery_layout() always creates fip (0x100000
 * static) plus ubootenv/ubootenv2 (0x1f000 dynamic), and then every subnode of
 * this node in order. The names and sizes below are therefore the volumes the
 * recovery page writes and the ones Linux binds to later by volname.
 *
 * Do not switch this board to the Nokia "bosa"/"ri" pair. H3C has no such
 * volumes on the Linux side: board.d/03_pon_data writes pon_data_target
 * "factory ubi 1048576" and platform.sh gates sysupgrade on
 * airoha_require_ubi_layout factory, so a bosa/ri layout makes the installer
 * refuse to flash and leaves every nvmem cell without a provider.
 */
&recovery_layout {
	factory {
		volume-name = "factory";
		volume-size = <0x100000>;
		volume-type = "dynamic";
		bootph-all;
	};
};

&gdm1 {
	/* Recovery networking requires gdm1 before relocation. */
	status = "okay";
	bootph-all;
};
